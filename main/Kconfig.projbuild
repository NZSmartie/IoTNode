## main/Kconfig.projbuild
```kconfig
menu "IoTNode Configuration"

config IOTNODE_HOSTNAME
    string "Hostname"
    default "IoTNode"
    help
        Hostname for the network interface.

config IOTNODE_MODEL
    string "Model"
    default "ESP32-Prototype"
    help
        Hostname for the network interface.

config IOTNODE_PLATFORM_UUID
    string "Platform ID. Unique to the physical device (Not to be confused with Device ID)"
    default "00000000-0000-0000-0000-000000000000"
    help
        UUID used to uniquely identify this physical device.

config IOTNODE_MANUFACTURER_NAME
    string "Your (company) name"
    default "Roman Vaughan (NZSmartie)"
    help
        Manufactuerer's name for device to report.

config IOTNODE_MANUFACTURER_URL
    string "Your (company) name"
    default "https://github.com/NZSmartie"
    help
        Manufactuerer's Website.

endmenu
```

## sdkconfig.defaults
```kconfig
#
# IoTNode Configuration
#
CONFIG_IOTNODE_HOSTNAME="IoTNode"
CONFIG_IOTNODE_MODEL="ESP32-Prototype"
CONFIG_IOTNODE_PLATFORM_UUID="06d1d358-5768-4556-943e-492c8093547a"
CONFIG_IOTNODE_MANUFACTURER_NAME="Roman Vaughan (NZSmartie)"
CONFIG_IOTNODE_MANUFACTURER_URL="https://github.com/NZSmartie"

#
# Compiler options
#
CONFIG_OPTIMIZATION_LEVEL_DEBUG=y
CONFIG_OPTIMIZATION_ASSERTIONS_ENABLED=y

#
# ESP32-specific
#
CONFIG_CONSOLE_UART_BAUDRATE=115200
```
